## xradio/Kconfig
```kconfig
config WLAN_VENDOR_XRADIO
	tristate "XRADIO WLAN support"
	depends on MAC80211
	default n
	help

	 This is an experimental driver for the XRADIO chip-set.
	 Enabling this option enables the generic driver without
	 any platform support.
	 Please select the appropriate platform below.

config XRADIO_SDIO
	bool

config XRADIO_USE_EXTENSIONS
	bool

config XRADIO_5GHZ_SUPPORT
	bool

if WLAN_VENDOR_XRADIO

config XRADIO_XR819
	bool "XRADIO XR819 support"
	depends on WLAN_VENDOR_XRADIO
	select XRADIO_SDIO
	select XRADIO_USE_EXTENSIONS
	select XRADIO_5GHZ_SUPPORT
	default y

config XRADIO_NON_POWER_OF_TWO_BLOCKSIZES
	bool "Platform supports non-power-of-two SDIO transfer"
	depends on WLAN_VENDOR_XRADIO
	default y
	help
	  Say N here only if you are running the driver on a platform
	  which does not have support for non-power-of-two SDIO transfer.
	  If unsure, say Y.

config XRADIO_5GHZ_SUPPORT
	bool "5GHz band support"
	depends on WLAN_VENDOR_XRADIO
	default n
	help
	  Say Y if your device supports 5GHz band. If unsure, say N.

config XRADIO_WAPI_SUPPORT
	bool "WAPI support"
	depends on WLAN_VENDOR_XRADIO
	default n
	help
	  Say Y if your compat-wireless support WAPI.
	  If unsure, say N.

config XRADIO_USE_EXTENSIONS
	bool "Extensions for WFD and PS mode"
	depends on WLAN_VENDOR_XRADIO
	default y
	help
	  Say Y if you want to include XR extensions
	  If unsure, say Y.

endif
```
